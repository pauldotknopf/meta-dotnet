## conf/layer.conf
```bitbake
# We have a conf and classes directory, add to BBPATH
BBPATH .= ":${LAYERDIR}"

# We have recipes-* directories, add to BBFILES
BBFILES += "${LAYERDIR}/recipes-*/*/*.bb \
            ${LAYERDIR}/recipes-*/*/*.bbappend"

BBFILE_COLLECTIONS += "dotnet"
BBFILE_PATTERN_dotnet = "^${LAYERDIR}/"
BBFILE_PRIORITY_dotnet = "6"

LAYERSERIES_COMPAT_dotnet = "sumo"

PNBLACKLIST[lttng-ust] = "Causes issue/hang with .NET CoreCLR"
```
